## RT288x_SDK/source/mediatek/kernel/Kconfig.wcn
```kconfig
menu "Ralink Module"

###########
# Debuging
###########
source "drivers/net/rt_rdm/Kconfig"

#############
# Wire
#############

source "drivers/net/raeth/Kconfig"

config  HW_IPSEC
	depends on RALINK_MT7621
	bool    "HW IPSec Enable"
	    select INET_AH
		select INET_ESP
		select INET_XFRM_MODE_TRANSPORT
		select INET_XFRM_MODE_TUNNEL
		select UNIX
		select XFRM
		select XFRM_USER
		select NET_KEY
		select CRYPTO_AEAD
		select CRYPTO_AUTHENC
		select CRTPTO_RNG
		select CRYPTO_CBC
		select CRYPTO_HMAC
		select CRYPTO_SHA1
		select CRYPTO_MD5
		select CRYPTO_AES
		select CRYPTO_DES
		select CRYPTO_ANSI_CPRNG
		default n

config  RALINK_HWCRYPTO
	depends on HW_IPSEC
	tristate "HW Crypto Engine"
	default m

#############
# Wireless
#############
menuconfig WIFI_DRIVER
	bool "WiFi Driver Support"

if WIFI_DRIVER

choice
	prompt "Choose First WiFi Interface"
	config FIRST_IF_NONE
	bool "None"

	config FIRST_IF_MT7612E
	bool "MT7612E"
	depends on RALINK_MT7621
	select RLT_MAC
	select RALINK_MT7612E

	config FIRST_IF_MT7602E
	bool "MT7602E"
	depends on RALINK_MT7621
	select RLT_MAC
	select RALINK_MT7602E
endchoice

choice
	prompt "Choose Second WiFi Interface"
	config SECOND_IF_NONE
	bool "None"

	config SECOND_IF_MT7612E
	bool "MT7612E"
	select RLT_MAC
	select RALINK_MT7612E

	config SECOND_IF_MT7602E
	bool "MT7602E"
	select RLT_MAC
	select RALINK_MT7602E
endchoice

config  RT_FIRST_CARD
        int
        depends on ! FIRST_IF_NONE
	default 7612e if FIRST_IF_MT7612E
	default 7602e if FIRST_IF_MT7602E
        
config  RT_SECOND_CARD
        int
        depends on ! SECOND_IF_NONE
	default 7612e if SECOND_IF_MT7612E
	default 7602e if SECOND_IF_MT7602E
        
config  RT_FIRST_IF_RF_OFFSET
        hex
        depends on ! FIRST_IF_NONE
        default 0x40000

config  RT_SECOND_IF_RF_OFFSET
        hex
        depends on ! SECOND_IF_NONE
        default 0x48000

#source "drivers/net/wireless/rlt_wifi/Kconfig"

endif # WIFI_DRIVER


config RTDEV
	bool
	default y if WIFI_DRIVER && !SECOND_IF_NONE || RTDEV_MII
	default y if RTDEV_PLC

#######
# USB
#######

#######
# NAT
#######
choice
prompt "Ralink NAT Type"
	
config  RA_NAT_NONE
bool "None"
config  RA_NAT_HW
bool "Hardware"
endchoice

source "net/nat/hw_nat/Kconfig"


endmenu
```
